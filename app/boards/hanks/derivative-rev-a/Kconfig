## app/dts/bindings/behaviors/zmk,behavior-lock-mode.yaml
```yaml
# Copyright (c) 2024 The ZMK Contributors
# SPDX-License-Identifier: MIT

description: |
  Lock mode behavior: persists a locked flag and powers the keyboard off
  (System OFF) so that only the configured wake keys can wake it. On wake,
  early-boot verification requires exactly those keys held alone for 3
  seconds before the keyboard unlocks and boots normally; any other key or
  an early release puts it straight back to sleep. No-op while USB powered.

compatible: "zmk,behavior-lock-mode"

include: zero_param.yaml

properties:
  wake-columns:
    type: array
    required: true
    description: |
      Matrix-transform column indices of the keys that wake and unlock the
      keyboard (e.g. the columns of F and J).
```

## app/module/drivers/led/Kconfig
```kconfig
# Copyright (c) 2024 The ZMK Contributors
# SPDX-License-Identifier: MIT

menuconfig ZMK_LED_MAP
    bool "Unified LED Map (per-key RGB + indicators)"
    depends on ZMK_RGB_UNDERGLOW
    select ZMK_LOW_PRIORITY_WORK_QUEUE
    help
      Enable unified LED map support for per-key RGB effects,
      indicator LEDs, and underglow on a single LED strip.
      When enabled, this module takes ownership of the LED strip
      and performs a single update per tick.

if ZMK_LED_MAP

config ZMK_LED_MAP_PER_KEY_BRT_MAX
    int "Per-key LED maximum brightness in percent"
    range 0 100
    default 10

config ZMK_LED_MAP_REACTIVE_BRT_MAX
    int "Reactive/starry effect maximum brightness in percent"
    range 0 100
    default ZMK_LED_MAP_PER_KEY_BRT_MAX
    help
      Brightness ceiling for the dynamic reactive-fade and starry effects,
      letting keypress flashes and twinkles exceed the steady per-key cap.
      Defaults to the per-key maximum; 0 turns those effects' output off.

config ZMK_LED_MAP_INDICATOR_BRT_MAX
    int "Indicator LED maximum brightness in percent"
    range 0 100
    default 10

config ZMK_LED_MAP_GAMMA_CORRECTION
    bool "Gamma-correct LED output (perceptual brightness)"
    default y
    help
      Apply a gamma 2.2 lookup to the final frame before it is sent to the
      strip, so configured brightness percentages behave perceptually rather
      than as linear PWM duty. Colors render truer at low brightness and the
      same apparent brightness draws less LED current. Disable for raw
      linear output.

config ZMK_LED_MAP_LOW_BAT_WARN_LEVEL
    int "Automatic low-battery warning threshold in percent (0 = disabled)"
    range 0 100
    default 15
    help
      When the battery state of charge drops to this level (and the keyboard
      is not USB powered), automatically trigger the battery level display.
      It re-warns after each further 5% drop and re-arms when charged back
      above the threshold.

config ZMK_LED_MAP_FADE_STEP
    int "Reactive keypress fade step per tick (higher = faster fade)"
    range 1 50
    default 47

config ZMK_LED_MAP_HUE_START
    int "Per-key initial hue (0-359)"
    range 0 359
    default 0

config ZMK_LED_MAP_SAT_START
    int "Per-key initial saturation (0-100)"
    range 0 100
    default 100

config ZMK_LED_MAP_BRT_START
    int "Per-key initial brightness (0-100)"
    range 0 100
    default 10

config ZMK_LED_MAP_SPD_START
    int "Per-key initial animation speed (1-5)"
    range 1 5
    default 3

config ZMK_LED_MAP_EFF_START
    int "Per-key initial effect (0=SOLID,1=BREATHE,2=SPECTRUM,3=SWIRL,4-7=REACTIVE_FADE,8-13=ROW_WAVE,14-19=COL_WAVE,20=STARRY)"
    range 0 20
    default 6

config ZMK_LED_MAP_ON_START
    bool "Per-key LEDs on at startup"
    default y

config ZMK_LED_MAP_INDICATORS_ON_START
    bool "Indicator LEDs on at startup"
    default y

config ZMK_LED_MAP_BAT_FLICK_PERIOD
    int "Battery indicator flick period in milliseconds"
    range 200 3000
    default 700

config ZMK_LED_MAP_CAPS_R
    int "Caps lock indicator red (0-255)"
    range 0 255
    default 255

config ZMK_LED_MAP_CAPS_G
    int "Caps lock indicator green (0-255)"
    range 0 255
    default 255

config ZMK_LED_MAP_CAPS_B
    int "Caps lock indicator blue (0-255)"
    range 0 255
    default 255

config ZMK_LED_MAP_LAYER1_R
    int "Layer 1 indicator red (0-255)"
    range 0 255
    default 255
config ZMK_LED_MAP_LAYER1_G
    int "Layer 1 indicator green (0-255)"
    range 0 255
    default 0
config ZMK_LED_MAP_LAYER1_B
    int "Layer 1 indicator blue (0-255)"
    range 0 255
    default 0

config ZMK_LED_MAP_LAYER2_R
    int "Layer 2 indicator red (0-255)"
    range 0 255
    default 0
config ZMK_LED_MAP_LAYER2_G
    int "Layer 2 indicator green (0-255)"
    range 0 255
    default 255
config ZMK_LED_MAP_LAYER2_B
    int "Layer 2 indicator blue (0-255)"
    range 0 255
    default 0

config ZMK_LED_MAP_LAYER3_R
    int "Layer 3 indicator red (0-255)"
    range 0 255
    default 0
config ZMK_LED_MAP_LAYER3_G
    int "Layer 3 indicator green (0-255)"
    range 0 255
    default 0
config ZMK_LED_MAP_LAYER3_B
    int "Layer 3 indicator blue (0-255)"
    range 0 255
    default 255

config ZMK_LED_MAP_LAYER4_R
    int "Layer 4 indicator red (0-255)"
    range 0 255
    default 255
config ZMK_LED_MAP_LAYER4_G
    int "Layer 4 indicator green (0-255)"
    range 0 255
    default 0
config ZMK_LED_MAP_LAYER4_B
    int "Layer 4 indicator blue (0-255)"
    range 0 255
    default 255

config ZMK_LED_MAP_LAYER5_R
    int "Layer 5 indicator red (0-255)"
    range 0 255
    default 255
config ZMK_LED_MAP_LAYER5_G
    int "Layer 5 indicator green (0-255)"
    range 0 255
    default 255
config ZMK_LED_MAP_LAYER5_B
    int "Layer 5 indicator blue (0-255)"
    range 0 255
    default 0

config ZMK_LED_MAP_LAYER6_R
    int "Layer 6 indicator red (0-255)"
    range 0 255
    default 0
config ZMK_LED_MAP_LAYER6_G
    int "Layer 6 indicator green (0-255)"
    range 0 255
    default 255
config ZMK_LED_MAP_LAYER6_B
    int "Layer 6 indicator blue (0-255)"
    range 0 255
    default 255

config ZMK_LED_MAP_LAYER7_R
    int "Layer 7 indicator red (0-255)"
    range 0 255
    default 255
config ZMK_LED_MAP_LAYER7_G
    int "Layer 7 indicator green (0-255)"
    range 0 255
    default 128
config ZMK_LED_MAP_LAYER7_B
    int "Layer 7 indicator blue (0-255)"
    range 0 255
    default 0

endif # ZMK_LED_MAP
```

## app/module/dts/bindings/kscan/zmk,kscan-595a.yaml
```yaml
# Copyright (c) 2024 The ZMK Contributors
# SPDX-License-Identifier: MIT

description: |
  ZMK kscan driver for 74HC595A shift register based key matrices.
  Uses GPIO bit-banging for shift register control.
  Compatible with luo_nice60 board interface.

compatible: "zmk,kscan-595a"

include: kscan.yaml

properties:
  hc595a-ser-gpios:
    type: phandle-array
    required: true
    description: GPIO pin for 74HC595A serial data input (SER/DS)

  hc595a-sck-gpios:
    type: phandle-array
    required: true
    description: GPIO pin for 74HC595A shift clock (SRCLK/SHCP)

  key-sense-gpios:
    type: phandle-array
    required: true
    description: GPIO pin to read key state (directly connected to all keys)

  hc595a-count:
    type: int
    required: true
    description: Number of 74HC595A shift registers in the chain

  settle-delay-us:
    type: int
    default: 10
    description: |
      Maximum microseconds to wait for the sense line to settle after
      selecting a column. The scan exits the wait early as soon as the line
      reads HIGH (released), so this bounds only the worst case: the line
      rising back through its pull-up after a pressed column, and the
      confirmation window for a genuine press. Lowering it below the line's
      actual rise time causes ghost presses on the columns following a held
      key — validate on hardware.

  poll-period-ms:
    type: int
    default: 1
    description: |
      Scan poll period in milliseconds. 1 matches the 1000Hz USB polling
      rate; raise to trade key latency for battery life.

  idle-timeout-ms:
    type: int
    default: 30
    description: |
      How long to keep polling after the last key release before switching
      to interrupt-driven wait: all columns are driven LOW and a sense-line
      level interrupt resumes polling on the first key press, so no scan
      work runs at all while no keys are held. 0 disables the interrupt
      wait and polls continuously.
```
