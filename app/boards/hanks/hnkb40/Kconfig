## app/boards/hanks/hnkb40/Kconfig
```kconfig
# Copyright (c) 2021 Nick Winans
# SPDX-License-Identifier: MIT

config BOARD_ENABLE_DCDC
    bool "Enable DCDC mode"
    select SOC_DCDC_NRF52
    default y
    depends on BOARD_HNKB40
```

## app/boards/hanks/hnkb40/Kconfig.defconfig
```kconfig
# Copyright (c) 2021 Nick Winans
# SPDX-License-Identifier: MIT

if BOARD_HNKB40

config ZMK_KEYBOARD_NAME
    default "hnkb40"

# This enables the core ZMK logic for the board
config ZMK
    bool
    default y

# Enable the 595 shift register GPIO driver
config GPIO_595
    default y

config SPI
    default y

if USB_DEVICE_STACK
config USB_NRFX
    default y
endif

endif # BOARD_HNKB40
```

## app/boards/hanks/hnkb40/Kconfig.hnkb40
```kconfig
# Copyright (c) 2021 Nick Winans
# SPDX-License-Identifier: MIT

config BOARD_HNKB40
    select SOC_NRF52840_QIAA
```

## app/boards/hanks/hnkb40/hnkb40_defconfig
```kconfig
CONFIG_ZMK=y
CONFIG_BT=y
CONFIG_GPIO=y
CONFIG_SPI=y

# Critical for your 74HC595 matrix
CONFIG_ZMK_GPIO_595=y

# Connectivity and Power
CONFIG_USB_DEVICE_STACK=y
CONFIG_USB_NRFX=y
CONFIG_BT_CTLR=y
CONFIG_ZMK_SLEEP=y
```

## app/boards/hanks/hnkb40/hnkb40_nrf52840_zmk_defconfig
```kconfig
# Copyright (c) 2021 Nick Winans
# SPDX-License-Identifier: MIT

# Note: CONFIG_BOARD_HNKB40 and SOC configs are auto-set by the build system

# Enable MPU
CONFIG_ARM_MPU=y

CONFIG_PINCTRL=y

# enable GPIO
CONFIG_GPIO=y

# SPI and LED strip (WS2812 driver auto-selected by devicetree)
CONFIG_SPI=y
CONFIG_LED_STRIP=y

CONFIG_USE_DT_CODE_PARTITION=y
CONFIG_BUILD_OUTPUT_UF2=y

CONFIG_MPU_ALLOW_FLASH_WRITE=y
CONFIG_NVS=y
CONFIG_SETTINGS_NVS=y
CONFIG_FLASH=y
CONFIG_FLASH_PAGE_LAYOUT=y
CONFIG_FLASH_MAP=y

CONFIG_ZMK_RGB_UNDERGLOW=y
CONFIG_ZMK_RGB_UNDERGLOW_ON_START=y
CONFIG_ZMK_RGB_UNDERGLOW_EXT_POWER=y
CONFIG_ZMK_EXT_POWER=y

# TEST: Force white at full brightness
CONFIG_ZMK_RGB_UNDERGLOW_HUE_START=0
CONFIG_ZMK_RGB_UNDERGLOW_SAT_START=0
CONFIG_ZMK_RGB_UNDERGLOW_BRT_START=100
CONFIG_ZMK_RGB_UNDERGLOW_EFF_START=0

# USB logging for debugging
CONFIG_ZMK_USB_LOGGING=y

# SPI debug logging
CONFIG_SPI_LOG_LEVEL_DBG=y
CONFIG_LED_STRIP_LOG_LEVEL_DBG=y

# Reset settings on start (remove after first flash)
CONFIG_ZMK_SETTINGS_RESET_ON_START=y


CONFIG_ZMK_USB=y
CONFIG_ZMK_BLE=y

# Enable deep sleep with wake-on-keypress
CONFIG_ZMK_SLEEP=y

# Note: Using zmk,kscan-595a driver with GPIO bit-banging (luo_nice60 compatible)
```

## app/module/dts/bindings/kscan/zmk,kscan-gpio-595-spi.yaml
```yaml
# Copyright (c) 2024 The ZMK Contributors
# SPDX-License-Identifier: MIT

description: |
  ZMK kscan driver for 74HC595 shift register based key matrices using SPI.
  Uses hardware SPI to drive the shift registers for reliable timing.

compatible: "zmk,kscan-gpio-595-spi"

include: [kscan.yaml, spi-device.yaml]

properties:
  sense-gpios:
    type: phandle-array
    required: true
    description: GPIO pin to read key state (directly connected to all keys)

  num-columns:
    type: int
    required: true
    description: Number of columns (shift register outputs)
```

## app/module/dts/bindings/kscan/zmk,kscan-gpio-595.yaml
```yaml
# Copyright (c) 2024 The ZMK Contributors
# SPDX-License-Identifier: MIT

description: |
  Optimized kscan driver for 74HC595 shift registers using "walking bit" method.

  Instead of using the shift register as a generic GPIO expander (which requires
  shifting N bits for each column), this driver shifts in a single "1" and walks
  it through the chain with one clock pulse per column.

  Performance: Reduces clock cycles from N*N to N+1 per scan (~47x faster for 48 columns).

  Example:
    kscan0: kscan {
        compatible = "zmk,kscan-gpio-595";
        ser-gpios = <&gpio1 14 GPIO_ACTIVE_HIGH>;
        sck-gpios = <&gpio1 13 GPIO_ACTIVE_HIGH>;
        rclk-gpios = <&gpio0 6 GPIO_ACTIVE_HIGH>;  /* optional */
        sense-gpios = <&gpio1 15 (GPIO_ACTIVE_HIGH | GPIO_PULL_DOWN)>;
        num-columns = <48>;
    };

compatible: "zmk,kscan-gpio-595"

include: kscan.yaml

properties:
  ser-gpios:
    type: phandle-array
    required: true
    description: Serial data pin connected to SER/DS on the first 74HC595

  sck-gpios:
    type: phandle-array
    required: true
    description: Shift clock pin connected to SRCLK/SHCP on all 74HC595s

  rclk-gpios:
    type: phandle-array
    required: false
    description: |
      Storage/latch clock pin connected to RCLK/STCP on all 74HC595s.
      If not specified, outputs update on every shift clock pulse.
      If specified, outputs only update when this pin is pulsed.

  sense-gpios:
    type: phandle-array
    required: true
    description: Key sense input pin to detect key presses

  num-columns:
    type: int
    required: true
    description: Number of columns (total shift register output bits)
```
